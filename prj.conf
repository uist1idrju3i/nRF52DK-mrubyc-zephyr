## CMakeLists.txt
```
# SPDX-License-Identifier: Apache-2.0

cmake_minimum_required(VERSION 3.20.0)
find_package(Zephyr REQUIRED HINTS $ENV{ZEPHYR_BASE})
project(nRF52DK-mrubyc-zephyr)

target_sources(app PRIVATE
                    src/main.c
                    src/sample1.c
                    src/sample2.c
                    heatshrink/heatshrink_encoder.c
                    heatshrink/heatshrink_decoder.c
                    src/lib/mrubyc/hal.c
                    mrubyc/src/alloc.c
                    mrubyc/src/c_array.c
                    mrubyc/src/c_hash.c
                    mrubyc/src/c_math.c
                    mrubyc/src/c_numeric.c
                    mrubyc/src/c_object.c
                    mrubyc/src/c_range.c
                    mrubyc/src/c_string.c
                    mrubyc/src/class.c
                    mrubyc/src/console.c
                    mrubyc/src/error.c
                    mrubyc/src/global.c
                    mrubyc/src/keyvalue.c
                    mrubyc/src/load.c
                    mrubyc/src/mrblib.c
                    mrubyc/src/rrt0.c
                    mrubyc/src/symbol.c
                    mrubyc/src/value.c
                    mrubyc/src/vm.c)

target_include_directories(app PRIVATE ${CMAKE_CURRENT_SOURCE_DIR}/src/lib/mrubyc ${CMAKE_CURRENT_SOURCE_DIR}/mrubyc/src)
```

## prj.conf
```kconfig
CONFIG_GPIO=y
CONFIG_NEWLIB_LIBC=y
CONFIG_FPU=y
CONFIG_COMPILER_OPT="-DMRBC_USE_FLOAT=1" # mruby/c VM 設定

#########################
# DEBUG
CONFIG_DEBUG=y
CONFIG_DEBUG_OPTIMIZATIONS=y

#########################
# printk
CONFIG_PRINTK=y
CONFIG_REQUIRES_FLOAT_PRINTF=y
CONFIG_LOG=y
CONFIG_USE_SEGGER_RTT=y
CONFIG_RTT_CONSOLE=y
CONFIG_UART_CONSOLE=n

#########################
# Thread analyzer
#CONFIG_THREAD_ANALYZER=y
#CONFIG_THREAD_ANALYZER_USE_PRINTK=y
#CONFIG_THREAD_ANALYZER_AUTO=y
#CONFIG_THREAD_ANALYZER_AUTO_INTERVAL=5
#CONFIG_THREAD_NAME=y
```

## src/main.c
```c
/*
 * Copyright (c) 2016 Intel Corporation
 *
 * SPDX-License-Identifier: Apache-2.0
 */

#include <stdint.h>
#include <zephyr/drivers/gpio.h>
#include <zephyr/kernel.h>
#include <zephyr/sys/printk.h>

#include "../heatshrink/heatshrink_common.h"
#include "../heatshrink/heatshrink_config.h"
#include "../heatshrink/heatshrink_decoder.h"
#include "../heatshrink/heatshrink_encoder.h"
#include "mrubyc.h"

#define LED0_NODE DT_ALIAS(led0)
static const struct gpio_dt_spec led = GPIO_DT_SPEC_GET(LED0_NODE, gpios);

/* ===== prototype ===== */
extern const uint8_t sample1[];
extern const uint8_t sample2[];
static void c_sw1_read(mrb_vm *vm, mrb_value *v, int argc);
static void c_led1_write(mrb_vm *vm, mrb_value *v, int argc);
static int compress_test(void);

/* ===== main ===== */
int main(void) {
  int ret;

  compress_test();

  if (!gpio_is_ready_dt(&led)) {
    return 0;
  }
  ret = gpio_pin_configure_dt(&led, GPIO_OUTPUT_ACTIVE);
  if (ret < 0) {
    return 0;
  }

  mrbc_define_method(0, mrbc_class_object, "sw1_read", c_sw1_read);
  mrbc_define_method(0, mrbc_class_object, "led1_write", c_led1_write);

  mrbc_create_task(sample1, 0);
  //  mrbc_create_task(sample2, 0);

  mrbc_run();

  return 0;
}

/* ===== c_sw1_read ===== */
static void c_sw1_read(mrb_vm *vm, mrb_value *v, int argc) {
  SET_INT_RETURN(1);  // DUMMY
}

/* ===== c_led1_write ===== */
static void c_led1_write(mrb_vm *vm, mrb_value *v, int argc) {
  gpio_pin_set_dt(&led, GET_INT_ARG(1));
}

const uint8_t kTestBytecode[] = {
    0x52, 0x49, 0x54, 0x45, 0x30, 0x33, 0x30, 0x30, 0x00, 0x00, 0x00, 0xa6,
    0x4d, 0x41, 0x54, 0x5a, 0x30, 0x30, 0x30, 0x30, 0x49, 0x52, 0x45, 0x50,
    0x00, 0x00, 0x00, 0x77, 0x30, 0x33, 0x30, 0x30, 0x00, 0x00, 0x00, 0x6b,
    0x00, 0x02, 0x00, 0x05, 0x00, 0x00, 0x00, 0x00, 0x00, 0x00, 0x00, 0x37,
    0x06, 0x01, 0x01, 0x02, 0x01, 0x07, 0x03, 0x42, 0x02, 0x27, 0x02, 0x00,
    0x05, 0x06, 0x01, 0x25, 0x00, 0x02, 0x07, 0x01, 0x2d, 0x02, 0x00, 0x00,
    0x06, 0x03, 0x42, 0x02, 0x27, 0x02, 0x00, 0x02, 0x07, 0x01, 0x01, 0x03,
    0x01, 0x2d, 0x02, 0x01, 0x01, 0x07, 0x03, 0x2d, 0x02, 0x02, 0x01, 0x25,
    0xff, 0xd0, 0x11, 0x02, 0x38, 0x02, 0x69, 0x00, 0x00, 0x00, 0x03, 0x00,
    0x08, 0x73, 0x77, 0x31, 0x5f, 0x72, 0x65, 0x61, 0x64, 0x00, 0x00, 0x0a,
    0x6c, 0x65, 0x64, 0x31, 0x5f, 0x77, 0x72, 0x69, 0x74, 0x65, 0x00, 0x00,
    0x05, 0x73, 0x6c, 0x65, 0x65, 0x70, 0x00, 0x4c, 0x56, 0x41, 0x52, 0x00,
    0x00, 0x00, 0x13, 0x00, 0x00, 0x00, 0x01, 0x00, 0x03, 0x6c, 0x65, 0x64,
    0x00, 0x00, 0x45, 0x4e, 0x44, 0x00, 0x00, 0x00, 0x00, 0x08,
};

static int compress_test(void) {
  heatshrink_encoder *hse = heatshrink_encoder_alloc(12, 6);
  //  heatshrink_decoder *hsd = heatshrink_decoder_alloc(256, 8, 3);
  uint8_t *input = (uint8_t *)kTestBytecode;
  size_t input_size = sizeof(kTestBytecode) / sizeof(kTestBytecode[0]);

  size_t comp_sz = input_size + (input_size / 2) + 4;
  //  size_t decomp_sz = input_size + (input_size / 2) + 4;
  uint8_t *comp = malloc(comp_sz);
  //  uint8_t *decomp = malloc(decomp_sz);
  memset(comp, 0, comp_sz);
  //  memset(decomp, 0, decomp_sz);

  size_t count = 0;

  size_t sunk = 0;
  size_t polled = 0;
  while (sunk < input_size) {
    HSE_sink_res esres =
        heatshrink_encoder_sink(hse, &input[sunk], input_size - sunk, &count);
    sunk += count;
    printk("^^ sunk %zd\n", count);
    if (sunk == input_size) {
      printk("%d\n", heatshrink_encoder_finish(hse));
    }

    HSE_poll_res pres;
    do { /* "turn the crank" */
      pres =
          heatshrink_encoder_poll(hse, &comp[polled], comp_sz - polled, &count);
      polled += count;
      printk("^^ polled %zd\n", count);
    } while (pres == HSER_POLL_MORE);
    if (sunk == input_size) {
      printk("%d\n", heatshrink_encoder_finish(hse));
    }
  }
  printk("in: %zu compressed: %zu ", input_size, polled);
  size_t compressed_size = polled;
  sunk = 0;
  polled = 0;
}
```

## src/hal.h
```c
/*! @file
  @brief
  Hardware abstraction layer
        for Zephyr.

  <pre>
  Copyright (C) 2015- Kyushu Institute of Technology.
  Copyright (C) 2015- Shimane IT Open-Innovation Center.

  This file is distributed under BSD 3-Clause License.
  </pre>
*/

#ifndef MRBC_SRC_HAL_H_
#define MRBC_SRC_HAL_H_

#include <zephyr/kernel.h>

#define MRBC_TICK_UNIT 1
#define MRBC_TIMESLICE_TICK_COUNT 10

#define hal_init() ((void)0)
#define hal_enable_irq() ((void)0)
#define hal_disable_irq() ((void)0)
#define hal_idle_cpu() ((k_msleep(MRBC_TICK_UNIT)), mrbc_tick())  // delay 1ms

int hal_write(int fd, const void *buf, int nbytes);
int hal_flush(int fd);
void hal_abort(const char *s);

/*
  or define the empty macros instead of function.
#define hal_write(fd,buf,nbytes)  ((void)0)
#define hal_flush(fd)             ((void)0)
#define hal_abort(s)              ((void)0)
*/

#endif
```

## src/sample1.c
```c
#include <stdint.h>
#ifdef __cplusplus
extern
#endif
const uint8_t sample1[] = {
0x52,0x49,0x54,0x45,0x30,0x33,0x30,0x30,0x00,0x00,0x00,0xa6,0x4d,0x41,0x54,0x5a,
0x30,0x30,0x30,0x30,0x49,0x52,0x45,0x50,0x00,0x00,0x00,0x77,0x30,0x33,0x30,0x30,
0x00,0x00,0x00,0x6b,0x00,0x02,0x00,0x05,0x00,0x00,0x00,0x00,0x00,0x00,0x00,0x37,
0x06,0x01,0x01,0x02,0x01,0x07,0x03,0x42,0x02,0x27,0x02,0x00,0x05,0x06,0x01,0x25,
0x00,0x02,0x07,0x01,0x2d,0x02,0x00,0x00,0x06,0x03,0x42,0x02,0x27,0x02,0x00,0x02,
0x07,0x01,0x01,0x03,0x01,0x2d,0x02,0x01,0x01,0x07,0x03,0x2d,0x02,0x02,0x01,0x25,
0xff,0xd0,0x11,0x02,0x38,0x02,0x69,0x00,0x00,0x00,0x03,0x00,0x08,0x73,0x77,0x31,
0x5f,0x72,0x65,0x61,0x64,0x00,0x00,0x0a,0x6c,0x65,0x64,0x31,0x5f,0x77,0x72,0x69,
0x74,0x65,0x00,0x00,0x05,0x73,0x6c,0x65,0x65,0x70,0x00,0x4c,0x56,0x41,0x52,0x00,
0x00,0x00,0x13,0x00,0x00,0x00,0x01,0x00,0x03,0x6c,0x65,0x64,0x00,0x00,0x45,0x4e,
0x44,0x00,0x00,0x00,0x00,0x08,
};
```

## src/sample2.c
```c
#include <stdint.h>
#ifdef __cplusplus
extern
#endif
const uint8_t sample2[] = {
0x52,0x49,0x54,0x45,0x30,0x33,0x30,0x30,0x00,0x00,0x00,0xa6,0x4d,0x41,0x54,0x5a,
0x30,0x30,0x30,0x30,0x49,0x52,0x45,0x50,0x00,0x00,0x00,0x77,0x30,0x33,0x30,0x30,
0x00,0x00,0x00,0x6b,0x00,0x02,0x00,0x05,0x00,0x00,0x00,0x00,0x00,0x00,0x00,0x37,
0x06,0x01,0x01,0x02,0x01,0x07,0x03,0x42,0x02,0x27,0x02,0x00,0x05,0x06,0x01,0x25,
0x00,0x02,0x07,0x01,0x2d,0x02,0x00,0x00,0x06,0x03,0x42,0x02,0x27,0x02,0x00,0x02,
0x07,0x01,0x01,0x03,0x01,0x2d,0x02,0x01,0x01,0x08,0x03,0x2d,0x02,0x02,0x01,0x25,
0xff,0xd0,0x11,0x02,0x38,0x02,0x69,0x00,0x00,0x00,0x03,0x00,0x08,0x73,0x77,0x31,
0x5f,0x72,0x65,0x61,0x64,0x00,0x00,0x0a,0x6c,0x65,0x64,0x31,0x5f,0x77,0x72,0x69,
0x74,0x65,0x00,0x00,0x05,0x73,0x6c,0x65,0x65,0x70,0x00,0x4c,0x56,0x41,0x52,0x00,
0x00,0x00,0x13,0x00,0x00,0x00,0x01,0x00,0x03,0x6c,0x65,0x64,0x00,0x00,0x45,0x4e,
0x44,0x00,0x00,0x00,0x00,0x08,
};
```
